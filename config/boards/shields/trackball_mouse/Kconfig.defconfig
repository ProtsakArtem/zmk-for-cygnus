## config/boards/shields/trackball_mouse/Kconfig.defconfig
```kconfig
if ZMK_SHIELD_TRACKBALL_MOUSE

config ZMK_KEYBOARD_NAME
    default "ZMK Trackball"

config ZMK_MOUSE
    default y

endif
```

## config/boards/shields/trackball_mouse/Kconfig.shield
```kconfig
config ZMK_SHIELD_TRACKBALL_MOUSE
    bool "Trackball mouse (PMW3610) on nice_nano"
    select ZMK_POINTING
```
